## boards/shields/Otter/Kconfig.defconfig
```kconfig
config ZMK_PM_SOFT_OFF
	default y
config ZMK_POINTING
	default y


if SHIELD_OTTER_LEFT

# Name must be less than 16 characters long!
config ZMK_KEYBOARD_NAME
    default "otter"

config ZMK_SPLIT_ROLE_CENTRAL
    default y

endif

if SHIELD_OTTER_LEFT || SHIELD_OTTER_RIGHT

config ZMK_SPLIT
    default y

endif
```

## config/boards/shields/Otter/Kconfig.defconfig
```kconfig
if SHIELD_OTTER_LEFT

# Name must be less than 16 characters long!
config ZMK_KEYBOARD_NAME
    default "Otter_left"

config ZMK_SPLIT_ROLE_CENTRAL
    default 

endif

config ZMK_KEYBOARD_NAME
    default "Otter_right
if SHIELF_OTTER_RIGHT
config ZMK_SPLIT_ROLE_CENTRAL n 

endif

if SHIELD_OTTER_DONGLE
config ZMK_SPLIT_ROLE_CENTRAL  
    default y
config ZMK_KEYBOARD_NAME
    default "Otter_dongle"

endif

if SHIELD_OTTER_LEFT || SHIELD_OTTER_RIGHT || SHIELD_OTTER_DONGLE

config ZMK_SPLIT
    default y

config ZMK_BLE
    default y

endif
```

## config/boards/shields/Otter/Kconfig.shield
```kconfig
config SHIELD_OTTER_LEFT
    def_bool $(shields_list_contains,Otter_left)

config SHIELD_OTTER_RIGHT
    def_bool $(shields_list_contains,Otter_right)

config SHIELD_OTTER_DONGLE
    def_bool $(shields_list_contains,Otter_dongle)
```

## config/boards/shields/Otter_dongle/Kconfig.defconfig
```kconfig
if SHIELD_OTTER_DONGLE

# Max 16 characters in keyboard name
config ZMK_KEYBOARD_NAME
    default "otter dongle"

config ZMK_SPLIT_ROLE_CENTRAL
    default y

config ZMK_SPLIT
    default y

# Number of peripherals (left + right halves = 2)
config ZMK_SPLIT_BLE_CENTRAL_PERIPHERALS
    default 2

# Peripherals + BT profiles (default profiles = 5)
config BT_MAX_CONN
    default 7

config BT_MAX_PAIRED
    default 7

endif
```
